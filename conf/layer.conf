## conf/layer.conf
```bitbake
#
#   Copyright (C) 2017 Pelagicore AB
#   SPDX-License-Identifier: MIT
#

# We have a conf and classes directory, append to BBPATH
BBPATH .= ":${LAYERDIR}"

# We have a recipes directory, add to BBFILES
BBFILES += " \
    ${LAYERDIR}/recipes-*/*/*.bb       \
    ${LAYERDIR}/recipes-*/*/*.bbappend \
"

BBFILE_COLLECTIONS += "template-layer"
BBFILE_PATTERN_template-layer := "^${LAYERDIR}/"

# Setting this variable allows you to prioritize a layer against other
# layers that contain the same recipe. A larger value for the 
# BBFILE_PRIORITY variable results in a higher precedence. 
BBFILE_PRIORITY_template-layer = "7"
```
